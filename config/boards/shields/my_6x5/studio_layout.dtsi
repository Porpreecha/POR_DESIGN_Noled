/ {
    studio_layout: studio_layout_0 {
        compatible = "zmk,studio-layout";
        zmk,layout-label = "My 6x5";
        zmk,layout-description = "Custom 6x5 keyboard layout";

        keys = <
            0 0 0 0
            1 19 0 0
            2 38 0 0
            3 57 0 0
            4 76 0 0
            5 95 0 0

            6 0 19 0
            7 19 19 0
            8 38 19 0
            9 57 19 0
            10 76 19 0
            11 95 19 0

            12 0 38 0
            13 19 38 0
            14 38 38 0
            15 57 38 0
            16 76 38 0
            17 95 38 0

            18 0 57 0
            19 19 57 0
            20 38 57 0
            21 57 57 0
            22 76 57 0
            23 95 57 0

            24 0 76 0
            25 19 76 0
            26 38 76 0
            27 57 76 0
            28 76 76 0
            29 95 76 0
        >;
    };
};

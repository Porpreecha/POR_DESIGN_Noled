/ {
    kscan0: kscan {
        compatible = "zmk,kscan-gpio-matrix";
        diode-direction = "col2row";

        row-gpios = <&gpio0 6 (GPIO_ACTIVE_LOW | GPIO_PULL_UP)>,
                    <&gpio0 8 (GPIO_ACTIVE_LOW | GPIO_PULL_UP)>,
                    <&gpio0 17 (GPIO_ACTIVE_LOW | GPIO_PULL_UP)>,
                    <&gpio0 20 (GPIO_ACTIVE_LOW | GPIO_PULL_UP)>,
                    <&gpio0 10 (GPIO_ACTIVE_LOW | GPIO_PULL_UP)>;
        col-gpios = <&gpio0 24 (GPIO_ACTIVE_HIGH | GPIO_PULL_DOWN)>,
                    <&gpio1 0 (GPIO_ACTIVE_HIGH | GPIO_PULL_DOWN)>,
                    <&gpio1 1 (GPIO_ACTIVE_HIGH | GPIO_PULL_DOWN)>,
                    <&gpio1 2 (GPIO_ACTIVE_HIGH | GPIO_PULL_DOWN)>,
                    <&gpio1 4 (GPIO_ACTIVE_HIGH | GPIO_PULL_DOWN)>,
                    <&gpio1 11 (GPIO_ACTIVE_HIGH | GPIO_PULL_DOWN)>;
    };

    default_transform: keymap_transform_0 {
        compatible = "zmk,matrix-transform";
        rows = <5>;
        columns = <6>;

        // index = row * columns + col
        map = <
            0  1  2  3  4  5
            6  7  8  9  10 11
            12 13 14 15 16 17
            18 19 20 21 22 23
            24 25 26 27 28 29
        >;
    };

    chosen {
        zmk,kscan = &kscan0;
        zmk,matrix-transform = &default_transform;
    };
};

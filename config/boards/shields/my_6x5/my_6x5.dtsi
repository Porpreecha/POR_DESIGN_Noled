/ {
    compatible = "zmk,keyboard-shield";

    chosen {
        zmk,kscan = &kscan0;
    };

    kscan0: kscan {
        compatible = "zmk,kscan-gpio-matrix";
        diode-direction = "col2row";
        rows = <6>;
        cols = <5>;
    };
};

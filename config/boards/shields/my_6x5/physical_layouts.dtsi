/ {
    zmk,physical-layouts {
        compatible = "zmk,physical-layouts";

        default: layout_0 {
            label = "Default";
            keys = <
                // row 0
                0   0    25  0    50  0    75  0    100 0
                // row 1
                0  25    25 25    50 25    75 25    100 25
                // row 2
                0  50    25 50    50 50    75 50    100 50
                // row 3
                0  75    25 75    50 75    75 75    100 75
                // row 4
                0 100    25 100   50 100   75 100   100 100
                // row 5
                0 125    25 125   50 125   75 125   100 125
            >;
        };
    };
};

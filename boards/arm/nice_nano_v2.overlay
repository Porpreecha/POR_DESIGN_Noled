&kscan {
    compatible = "zmk,kscan-gpio-matrix";
    row-gpios = <&gpio0 2 GPIO_ACTIVE_HIGH>,  /* P0.02 */
                <&gpio0 3 GPIO_ACTIVE_HIGH>,  /* P0.03 */
                <&gpio0 4 GPIO_ACTIVE_HIGH>,  /* P0.04 */
                <&gpio0 5 GPIO_ACTIVE_HIGH>,  /* P0.05 */
                <&gpio0 6 GPIO_ACTIVE_HIGH>,  /* P0.06 */
                <&gpio0 7 GPIO_ACTIVE_HIGH>;  /* P0.07 */

    col-gpios = <&gpio0 8 GPIO_ACTIVE_HIGH>,  /* P0.08 */
                <&gpio0 9 GPIO_ACTIVE_HIGH>,  /* P0.09 */
                <&gpio0 10 GPIO_ACTIVE_HIGH>, /* P0.10 */
                <&gpio0 11 GPIO_ACTIVE_HIGH>, /* P0.11 */
                <&gpio0 12 GPIO_ACTIVE_HIGH>; /* P0.12 */

    debounce-interval = <30>;
};
